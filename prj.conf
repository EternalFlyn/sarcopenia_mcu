## prj.conf
```kconfig
CONFIG_STDOUT_CONSOLE=y
CONFIG_PRINTK=y

CONFIG_FPU=y

CONFIG_I2C=y

CONFIG_ADC=y
CONFIG_ADC_ASYNC=y
CONFIG_ADC_NRFX_SAADC=y

CONFIG_BT=y
CONFIG_BT_DEBUG_LOG=y
CONFIG_BT_SMP=y
CONFIG_BT_SIGNING=y
CONFIG_BT_PERIPHERAL=y
CONFIG_BT_PRIVACY=y
CONFIG_BT_DEVICE_NAME="AFoot Signal Test"
CONFIG_BT_DEVICE_NAME_DYNAMIC=y
CONFIG_BT_DEVICE_NAME_MAX=65

CONFIG_BT_GATT_CLIENT=y
CONFIG_BT_L2CAP_TX_MTU=247
CONFIG_BT_L2CAP_DYNAMIC_CHANNEL=y
CONFIG_BT_BUF_ACL_TX_COUNT=64
CONFIG_BT_BUF_ACL_TX_SIZE=240
CONFIG_BT_BUF_ACL_RX_SIZE=240

CONFIG_BT_KEYS_OVERWRITE_OLDEST=y
CONFIG_FLASH=y
CONFIG_FLASH_PAGE_LAYOUT=y
CONFIG_FLASH_MAP=y
CONFIG_NVS=y
CONFIG_SETTINGS=y

CONFIG_CLOCK_CONTROL_NRF_K32SRC_RC=y
```

## nrf52840dk_nrf52840.overlay
```dts
&adc {
    status = "okay";
};
```

## src/main.c
```c
/*
 * Copyright (c) 2012-2014 Wind River Systems, Inc.
 *
 * SPDX-License-Identifier: Apache-2.0
 */

#include <zephyr.h>
#include <device.h>
#include <sys/printk.h>
#include <devicetree.h>
#include <drivers/gpio.h>

#include "flyn_bluetooth.h"
#include "adc.h"
#include "battery.h"

#define ADC_DEVICE_NAME DT_LABEL(DT_INST(0, nordic_nrf_saadc))

#define THREAD_STACK_SIZE 500
#define THREAD_PRIORITY 5

const struct device *adc_dev;

void main(void) {
	printk("Hello World! %s\n", CONFIG_BOARD);

	// ADC setup
    adc_dev = device_get_binding(ADC_DEVICE_NAME);
	if (adc_init(adc_dev)) return;
	if (battery_init(adc_dev)) return;
	if (bt_init()) return;

	if (start_battery_sample()) return;
}
```
